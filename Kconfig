## Kconfig
```kconfig
menuconfig ZMK_BEHAVIOR_CANCELABLE_TEXT
    bool "Cancelable text behavior"
    default y
    help
      Type configured text at a fixed rate. Pressing any cancelable text
      behavior while one is active stops the current text immediately.
```

## dts/bindings/behaviors/kirill,behavior-cancelable-text.yaml
```yaml
description: Cancelable text behavior

compatible: "kirill,behavior-cancelable-text"

include: zero_param.yaml

properties:
  text:
    type: string
    required: true
  wait-ms:
    type: int
    default: 30
  tap-ms:
    type: int
    default: 30
```
