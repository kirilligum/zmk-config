// Settings tuned for 3840 x 2160 display resolution
#define ZMK_POINTING_DEFAULT_MOVE_VAL 600 // 600
#define ZMK_POINTING_DEFAULT_SCRL_VAL 20  // 10

#include <dt-bindings/zmk/pointing.h>
#include <input/processors.dtsi>
#include <zephyr/dt-bindings/input/input-event-codes.h>

// Based on @caksoylar's config, defaults in comments
&mmv {
  acceleration-exponent = <1>;          // 1
  time-to-max-speed-ms = <500>;         // 300
  delay-ms = <0>;                       // 0
};

&msc {
  acceleration-exponent = <0>;          // 0
  time-to-max-speed-ms = <300>;         // 300
  delay-ms = <0>;                       // 0
};

&mmv_input_listener {
  warp {
    layers = <MOUSE_FAST>;
    input-processors = <&zip_xy_scaler 4 1>;
  };
  precision {
    layers = <MOUSE_PRECISION>;
    input-processors = <&zip_xy_scaler 1 4>;
  };
};

/ {
  zip_scroll_scaler: zip_scroll_scaler {
    compatible = "zmk,input-processor-scaler";
    #input-processor-cells = <2>;
    type = <INPUT_EV_REL>;
    codes = <INPUT_REL_WHEEL INPUT_REL_HWHEEL>;
    track-remainders;
  };
};

&msc_input_listener {
  warp {
    layers = <MOUSE_FAST>;
    input-processors = <&zip_scroll_scaler 4 1>;
  };
  precision {
    layers = <MOUSE_PRECISION>;
    input-processors = <&zip_scroll_scaler 1 4>;
  };
};

// Tap for one-shot, hold for momentary, and double-tap for a persistent lock.
ZMK_TAP_DANCE(mouse_ctrl_tap, bindings = <&sk LCTRL>, <&kt LCTRL>;
              tapping-term-ms = <200>;)
ZMK_HOLD_TAP(mouse_ctrl, bindings = <&kp>, <&mouse_ctrl_tap>;
             flavor = "hold-preferred"; tapping-term-ms = <200>;)

ZMK_TAP_DANCE(mouse_shift_tap, bindings = <&sk LSHFT>, <&kt LSHFT>;
              tapping-term-ms = <200>;)
ZMK_HOLD_TAP(mouse_shift, bindings = <&kp>, <&mouse_shift_tap>;
             flavor = "hold-preferred"; tapping-term-ms = <200>;)

// The mouse window switcher keeps Alt held for two seconds after each Tab.
ZMK_KEY_TOGGLE(mouse_key_on, toggle-mode = "on";)
ZMK_KEY_TOGGLE(mouse_key_off, toggle-mode = "off";)
ZMK_TRI_STATE(mouse_window_left,
              bindings = <&mouse_key_on LALT>, <&kp TAB>, <&mouse_key_off LALT>;
              ignored-key-positions = <LB0>; timeout-ms = <2000>;)
ZMK_TRI_STATE(mouse_window_right,
              bindings = <&mouse_key_on LALT>, <&kp TAB>, <&mouse_key_off LALT>;
              ignored-key-positions = <RB0>; timeout-ms = <2000>;)

// LMB lock: the dedicated key holds the button; LMB or Mouse exit releases it.
#define MOUSE_L_LOCK_ON(NAME, LAYER)                                          \
  ZMK_MACRO(NAME, wait-ms = <0>; tap-ms = <0>;                               \
            bindings = <&macro_press &mkp LCLK &tog LAYER>;)

#define MOUSE_L_LOCK_OFF(NAME, LAYER)                                         \
  ZMK_MACRO(NAME, wait-ms = <0>; tap-ms = <0>;                               \
            bindings = <&macro_release &mkp LCLK                              \
                        &macro_press &tog LAYER>;)

MOUSE_L_LOCK_ON(mouse_left_l_lock_on, MOUSE_L_LOCK)
MOUSE_L_LOCK_OFF(mouse_left_l_lock_off, MOUSE_L_LOCK)
MOUSE_L_LOCK_ON(mouse_right_l_lock_on, MOUSE_R_LOCK)
MOUSE_L_LOCK_OFF(mouse_right_l_lock_off, MOUSE_R_LOCK)

// Mouse exit is a hard cleanup boundary: release every possible held button,
// force mouse-held modifiers off, clear Mouse sublayers, and return to Base.
ZMK_MACRO(mouse_clear_exit, wait-ms = <0>; tap-ms = <0>;
          bindings = <&macro_release &mkp RCLK &mkp MCLK &mkp LCLK
                      &macro_press &mouse_key_off LCTRL
                      &mouse_key_off LCTRL
                      &mouse_key_off LSHFT
                      &mouse_key_off LSHFT
                      &mouse_key_off LALT &to DEF>;)

#define U_MS_U &mmv MOVE_UP
#define U_MS_D &mmv MOVE_DOWN
#define U_MS_L &mmv MOVE_LEFT
#define U_MS_R &mmv MOVE_RIGHT
#define U_WH_U &msc SCRL_UP
#define U_WH_D &msc SCRL_DOWN
#define U_WH_L &msc SCRL_LEFT
#define U_WH_R &msc SCRL_RIGHT
