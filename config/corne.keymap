#define CONFIG_WIRELESS
#define ZMK_BASE_LAYER(name, LT, RT, LM, RM, LB, RB, LH, RH, LO, RO)           \
    ZMK_LAYER(                                                                 \
        name,                                                                  \
                 LT RT                                                         \
                 LM RM                                                         \
                 LB RB                                                         \
                 LO LH RH RO                                                   \
    )

#include "zmk-helpers/key-labels/36.h"
#include "base.keymap"
#include "prompts.dtsi"

/{ chosen { zmk,physical-layout = &foostan_corne_5col_layout; }; };
